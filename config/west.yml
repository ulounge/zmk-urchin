## config/west.yml
```yaml
manifest:
  remotes:
    # zmk official
    - name: zmkfirmware
      url-base: https://github.com/zmkfirmware
      # bravekarma
    - name: caksoylar
      url-base: https://github.com/caksoylar
      # kyek / duckyb
    - name: duckyb
      url-base: https://github.com/duckyb
      # If you don't use animation delete from Here
      # ulounge
    - name: ulounge
      url-base: https://github.com/ulounge
      # To Here
  projects:
    - name: zmk
      remote: zmkfirmware
      revision: main
      import: app/west.yml
    - name: urchin-zmk-module
      remote: duckyb
      revision: main
      # If you don't use animation delete from Here
    - name: nice-view-mod   
      remote: ulounge                       
      revision: main
      # To Here                      
  self:
    path: config
```
